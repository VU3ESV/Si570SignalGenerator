// Si570 signal generator for a 30-pin ESP32-WROOM-32 DevKit.
//
// Control: the web page (http://Si570-SigGen.local/, or the set-up hotspot), the USB
// serial console ("help"), and optionally a rotary encoder with a 16x2 LCD or 128x64 OLED.
// The encoder and display are optional: without them the generator runs headless.
#include <Arduino.h>
#include <Wire.h>
#include <ctype.h>
#include <stdlib.h>

#include "build_stamp.h"  // generated by tools/build_stamp.py
#include "config.h"
#include "controller.h"
#include "display.h"
#include "encoder_input.h"
#include "net.h"
#include "settings.h"
#include "web_portal.h"

namespace cfg {
const char kFirmwareBuild[] = SIGGEN_BUILD_STAMP;
}

namespace {

constexpr uint32_t kRenderIntervalMs = 40;

Controller controller;
Net net;
WebPortal web;
EncoderInput encoder;
std::unique_ptr<Display> display;

DisplayModel shown;
uint32_t lastRenderMs = 0;
uint32_t renderAfterMs = 0;
char consoleLine[100];
size_t consoleLen = 0;

void render(bool force) {
  const uint32_t now = millis();
  if (!force && ((int32_t)(now - renderAfterMs) < 0 || now - lastRenderMs < kRenderIntervalMs)) return;
  const DisplayModel m = controller.displayModel();
  if (!force && m == shown) return;
  display->render(m);
  shown = m;
  lastRenderMs = now;
}

// Notices from Wi-Fi / OTA / web update. Drawn immediately because an OTA upload
// blocks the loop until it finishes.
void notify(const char* text) {
  controller.showMessage(8000, "%s", text);
  render(true);
}

// ---------------------------------------------------------------- serial console

// "14250000", "14.25M", "7050k" -> Hz. False if it doesn't parse.
bool parseFrequency(const char* text, uint32_t& hz) {
  char* end = nullptr;
  double v = strtod(text, &end);
  if (end == text) return false;
  if (*end == 'M' || *end == 'm') v *= 1e6, ++end;
  else if (*end == 'k' || *end == 'K') v *= 1e3, ++end;
  if (*end != '\0' || v < 0 || v > 4.0e9) return false;
  hz = (uint32_t)(v + 0.5);
  return true;
}

void report(CmdResult r) { Serial.printf("%s\n", cmdResultText(r)); }

void runCommand(char* line) {
  char* cmd = strtok(line, " ");
  if (cmd == nullptr) return;
  char* arg = strtok(nullptr, " ");
  char* arg2 = strtok(nullptr, "");

  if (!strcmp(cmd, "help")) {
    Serial.println(
        "f <Hz|14.25M|7050k>  set frequency     step <0-8>       1 Hz ... 100 MHz\n"
        "rf on|off            RF output         ref int|ext      reference\n"
        "cal                  calibrate (EXT)   save             save as power-on default\n"
        "status               status JSON       wifi <ssid> [password]  join a network, reboot\n"
        "auth clear           drop admin pw     reset            factory reset\n"
        "reboot");
  } else if (!strcmp(cmd, "f") || !strcmp(cmd, "freq")) {
    uint32_t hz = 0;
    if (arg && parseFrequency(arg, hz)) report(controller.setFrequency(hz));
    else Serial.println("usage: f 14250000 | f 14.25M | f 7050k");
  } else if (!strcmp(cmd, "step") && arg) {
    report(controller.setStepIndex(atoi(arg)));
  } else if (!strcmp(cmd, "rf") && arg) {
    report(controller.setRfEnabled(!strcmp(arg, "on")));
  } else if (!strcmp(cmd, "ref") && arg) {
    report(controller.setRefMode(!strcmp(arg, "ext") ? RefMode::External : RefMode::Internal));
  } else if (!strcmp(cmd, "cal")) {
    report(controller.calibrate());
  } else if (!strcmp(cmd, "save")) {
    report(controller.saveState());
  } else if (!strcmp(cmd, "status")) {
    Serial.println(web.statusJson());
  } else if (!strcmp(cmd, "wifi") && arg) {
    NetConfig n = net.config();
    strncpy(n.ssid, arg, sizeof(n.ssid) - 1);
    n.ssid[sizeof(n.ssid) - 1] = '\0';
    strncpy(n.pass, arg2 ? arg2 : "", sizeof(n.pass) - 1);
    n.pass[sizeof(n.pass) - 1] = '\0';
    saveNetConfig(n);
    Serial.println("saved; rebooting");
    delay(200);
    ESP.restart();
  } else if (!strcmp(cmd, "auth") && arg && !strcmp(arg, "clear")) {
    clearAdminPassword();
    Serial.println("admin password cleared; rebooting");
    delay(200);
    ESP.restart();
  } else if (!strcmp(cmd, "reset")) {
    factoryReset();
    Serial.println("factory reset; rebooting");
    delay(200);
    ESP.restart();
  } else if (!strcmp(cmd, "reboot")) {
    ESP.restart();
  } else {
    Serial.println("unknown command, try: help");
  }
}

// Non-blocking line reader (Serial.readStringUntil would stall the loop for a second).
void pollConsole() {
  while (Serial.available()) {
    const char c = (char)Serial.read();
    if (c == '\r' || c == '\n') {
      consoleLine[consoleLen] = '\0';
      if (consoleLen > 0) runCommand(consoleLine);
      consoleLen = 0;
    } else if (consoleLen + 1 < sizeof consoleLine && isprint((unsigned char)c)) {
      consoleLine[consoleLen++] = c;
    }
  }
}

}  // namespace

void setup() {
  Serial.begin(115200);
  Serial.printf("\nSi570 signal generator v%s (%s)\n", cfg::kFirmwareVersion, cfg::kFirmwareBuild);

  Wire.begin(cfg::kPinSda, cfg::kPinScl, 100000);
  encoder.begin();
  const bool restoreDefaults = encoder.buttonDown();  // hold the encoder switch at power-up

  display = createDisplay();
  Wire.setClock(display->i2cClockHz());
  Serial.printf("Display: %s\n", display->name());
  char version[17];
  snprintf(version, sizeof version, "v%s", cfg::kFirmwareVersion);
  display->showSplash("Si570 SigGen", restoreDefaults ? "Defaults restored" : version);
  renderAfterMs = millis() + 1000;

  if (restoreDefaults) clearSettings();
  controller.begin(loadHardwareConfig(), loadSettings());

  const String adminPass = loadAdminPassword();
  net.begin(loadNetConfig(), adminPass, notify);
  web.begin(controller, net, adminPass, notify);
  Serial.println("Type 'help' for console commands.");
}

void loop() {
  const uint32_t now = millis();
  controller.loop(now);

  const int clicks = encoder.takeClicks();
  if (clicks != 0) controller.encoderClicks(clicks, now);
  switch (encoder.pollButton(now)) {
    case ButtonClassifier::Event::Short: controller.encoderShortPress(now); break;
    case ButtonClassifier::Event::Long: controller.encoderLongPress(now); break;
    case ButtonClassifier::Event::None: break;
  }

  net.loop(now);
  web.loop(now);
  pollConsole();
  render(false);
}
